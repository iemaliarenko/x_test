## CMakeLists.txt
```
# SPDX-License-Identifier: Apache-2.0

cmake_minimum_required(VERSION 3.20.0)

find_package(Zephyr REQUIRED HINTS $ENV{ZEPHYR_BASE})
project(hci_lpuart)

# NORDIC SDK APP START
target_sources(app PRIVATE main.c src/console_x_test.c src/beacon_x_test.c)
# NORDIC SDK APP END
```

## sample.yaml
```
sample:
  description: x test
  name: x test
tests:
  sample.bluetooth.beacon:
    harness: bluetooth
    platform_allow: nrf52840dk_nrf52840
    tags: uart bluetooth
```

## prj.conf
```kconfig
CONFIG_BT=y
#CONFIG_BT_DEBUG_LOG=y
CONFIG_BT_DEVICE_NAME="Beacon GPS x test"
CONFIG_SERIAL=y
CONFIG_UART_INTERRUPT_DRIVEN=y
CONFIG_NEWLIB_LIBC=y
```

## src/beacon_x_test.c
```c
#include "beacon_x_test.h"

#define DEVICE_NAME CONFIG_BT_DEVICE_NAME
#define DEVICE_NAME_LEN (sizeof(DEVICE_NAME) - 1)
#define MSG_SIZE 11

uint8_t mfg_data_lo[MSG_SIZE];
uint8_t mfg_data_la[MSG_SIZE];

static struct bt_data ad[] = {
	BT_DATA_BYTES(BT_DATA_FLAGS, (BT_LE_AD_GENERAL | BT_LE_AD_NO_BREDR)),
	BT_DATA(BT_DATA_NAME_SHORTENED, &mfg_data_lo, MSG_SIZE),
	BT_DATA(BT_DATA_NAME_SHORTENED, &mfg_data_la, MSG_SIZE)
};

static const struct bt_data sd[] = {
	BT_DATA(BT_DATA_NAME_COMPLETE, DEVICE_NAME, DEVICE_NAME_LEN),
};

static void bt_ready(int err)
{
	char addr_s[BT_ADDR_LE_STR_LEN];
	bt_addr_le_t addr = {0};
	size_t count = 1;

	if (err) {
		printk("Bluetooth init failed (err %d)\n", err);
		return;
	}

	printk("Bluetooth initialized\n");

	/* Start advertising */
	err = bt_le_adv_start(BT_LE_ADV_NCONN_IDENTITY, ad, ARRAY_SIZE(ad),
			      sd, ARRAY_SIZE(sd));
	if (err) {
		printk("Advertising failed to start (err %d)\n", err);
		return;
	}

	/* For connectable advertising you would use
	 * bt_le_oob_get_local().  For non-connectable non-identity
	 * advertising an non-resolvable private address is used;
	 * there is no API to retrieve that.
	 */

	bt_id_get(&addr, &count);
	bt_addr_le_to_str(&addr, addr_s, sizeof(addr_s));

	printk("Beacon started, advertising as %s\n", addr_s);
}

void init_beacon (void) {
	int err;
	err = bt_enable(bt_ready);
	if (err){
		printk("Advertising failed to start (err %d)\n", err);
	}
}

void update_beacon_data (void) {
	bt_le_adv_update_data(ad, ARRAY_SIZE(ad), sd, ARRAY_SIZE(sd));
}
```

## src/beacon_x_test.h
```c
#ifndef BEACON_X_TEST_H
#define BEACON_X_TEST_H

#include <zephyr/zephyr.h>
#include <zephyr/bluetooth/bluetooth.h>

#define MSG_SIZE 11
extern uint8_t mfg_data_lo[MSG_SIZE];
extern uint8_t mfg_data_la[MSG_SIZE];

void init_beacon (void);
void update_beacon_data (void);

#endif /* BEACON_X_TEST_H */
```

## src/console_x_test.c
```c
#include "console_x_test.h"

#define UART_DEVICE_NODE DT_CHOSEN(zephyr_shell_uart)
#define MSG_SIZE 12

static const struct device *uart_dev = DEVICE_DT_GET(UART_DEVICE_NODE);
static char rx_buf[MSG_SIZE];
static int rx_buf_pos;

K_MSGQ_DEFINE(uart_msgq, sizeof(rx_buf), 8, 4);

static void serial_cb(const struct device *dev, void *user_data) {
	uint8_t c;

	if (!uart_irq_update(uart_dev)) {
		return;
	}

	while (uart_irq_rx_ready(uart_dev)) {

		uart_fifo_read(uart_dev, &c, 1);

		if ((c == '\n' || c == '\r') && rx_buf_pos > 0) {
			/* terminate string */
			rx_buf[rx_buf_pos] = '\0';

			/* if queue is full, message is silently dropped */
			k_msgq_put(&uart_msgq, &rx_buf, K_NO_WAIT);

			/* reset the buffer (it was copied to the msgq) */
			rx_buf_pos = 0;
		} else if (rx_buf_pos < (sizeof(rx_buf) - 1)) {
			rx_buf[rx_buf_pos++] = c;
			uart_poll_out(uart_dev, c);
		}
		/* else: characters beyond buffer size are dropped */
	}
}

static bool validate_data (const char *data, uint8_t tlc) {
    
	for(int i = 0; i < strlen( data ); i ++) {
        //ASCII value of 0 = 48, 9 = 57.
        //Checking for "-", "."
        if ((data[i] < 48 || data[i] > 57) &&
			data[i] != 45 &&
			data[i] != 46 ) {
            return false;
	    }
    }

	if (-180.0000000 <= atof(data) && 
	    atof(data) <= 180.000000 && tlc == LONG) {
		return true;
	}
	if (-90.000000 <= atof(data) &&
	    atof(data) <= 90.000000 && tlc == LAT) {
		return true;
	}

	return false;
}

void print_uart(char *buf) {
	int msg_len = strlen(buf);

	for (int i = 0; i < msg_len; i++) {
		uart_poll_out(uart_dev, buf[i]);
	}
}

void init_console (void) {
    if (!device_is_ready(uart_dev)) {
		printk("Console not ready\n");
		return;
	}

	uart_irq_callback_user_data_set(uart_dev, serial_cb, NULL);
	uart_irq_rx_enable(uart_dev);
}

bool read_console_data (uint8_t *mfg_data_, uint8_t tlc) {
	char tx_buf[MSG_SIZE];
	memset(&rx_buf, ' ', MSG_SIZE);
	rx_buf_pos = 0;
    if (tlc == LONG){
        print_uart("Enter longtitude as 180.000000 ... -180.000000\r\n");
	}
	if (tlc == LAT){
        print_uart("Enter latitude as 90.000000 ... -90.000000\r\n");
	}

	k_msgq_get(&uart_msgq, &tx_buf, K_FOREVER);
	print_uart("\r\n");

	if (true == validate_data(rx_buf, tlc)){
		memcpy(mfg_data_, rx_buf, sizeof(rx_buf)-1);
		return true;
	}
	else {
		print_uart("Wrong data format, try ag\r\n");
		return false;
	}
}
```

## src/console_x_test.h
```c
#ifndef CONSOLE_X_TEST_H
#define CONSOLE_X_TEST_H

#include <stdio.h>
#include <stdlib.h>
#include <string.h>
#include <zephyr/zephyr.h>
#include <zephyr/drivers/uart.h>

#define LONG 1
#define LAT 2

void print_uart(char *buf);
void init_console (void);
bool read_console_data (uint8_t *mfg_data_lo, uint8_t tlc);

#endif /* CONSOLE_X_TEST_H */
```
